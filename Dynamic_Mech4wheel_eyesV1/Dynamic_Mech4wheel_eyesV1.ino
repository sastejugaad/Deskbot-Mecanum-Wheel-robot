/*
Mecanum wheel robot built by Shubahm Bhatt. You will need a android app to control this bot.
App is include with the code.
Tutorial video-
Use these link to learn more about how the data is sent and recieved over wifi
https://siytek.com/esp8266-udp-send-receive/
https://arduino.stackexchange.com/questions/1013/how-do-i-split-an-incoming-string  
*/

/*
The function is StringSplit() parse a String sLine = "1.12345,4.56789,hello" to 3 Strings sParams[0]="1.12345", sParams[1]="4.56789" & sParams[2]="hello".
String sInput: the input lines to be parsed,
char cDelim: the delimiter character between parameters,
String sParams[]: the output array of parameters,
int iMaxParams: the maximum number of parameters,
Output int: the number of parsed parameters,
*/

#include <ESP8266WiFi.h>
#include <WiFiUdp.h>
#include <Servo.h>
#include <SPI.h>
#include <Wire.h>
#include <Adafruit_GFX.h>
#include <Adafruit_SSD1306.h>   
// Set WiFi credentials
#define WIFI_SSID "SINGTEL-42E6" //Wifi name
#define WIFI_PASS "huiweimaev" //Wifi password
#define UDP_PORT 4210 //UDP port name

//OLED
#define SCREEN_WIDTH 128 // OLED display width, in pixels
#define SCREEN_HEIGHT 64 // OLED display height, in pixels
//#define OLED_RESET     4 // Reset pin # (or -1 if sharing Arduino reset pin)

Adafruit_SSD1306 display(SCREEN_WIDTH, SCREEN_HEIGHT, &Wire, -1);

 
// UDP
WiFiUDP UDP;
char packet[255];
char reply[] = "Packet received!";

String sParams[4];
int iCount, i;
String sLine;
double Direction = 0;

int cc_speed = 1300; //Clockwise speed
int cw_speed = 1700; //Counter clockwise speed

//Servo pins refer to circuit diagram
Servo fl;
Servo fr;
Servo bl;
Servo br;
//Speed varialbles for each wheel
int flss;
int frs;
int bls;
int brs;
//Code for eyes start from here
const unsigned char opened_eye[] PROGMEM = {
  0x00,0x00,0x00,0x00,0x00,0x00,0x00,0x00,0x00,0x00,0x00,0x00,0x00,0x00,0x00,0x00, // ................................................................................................................................
  0x00,0x00,0x00,0x00,0x00,0x00,0x00,0x00,0x00,0x00,0x00,0x00,0x00,0x00,0x00,0x00, // ................................................................................................................................
  0x00,0x00,0x00,0x00,0x00,0x00,0x00,0x00,0x00,0x00,0x00,0x00,0x00,0x00,0x00,0x00, // ................................................................................................................................
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  0x00,0x00,0x00,0x00,0x00,0x00,0x00,0x00,0x00,0x00,0x00,0x00,0x00,0x00,0x00,0x00  // ................................................................................................................................
};

const unsigned char semiopened_eye[] PROGMEM = {
  0x00,0x00,0x00,0x00,0x00,0x00,0x00,0x00,0x00,0x00,0x00,0x00,0x00,0x00,0x00,0x00, // ................................................................................................................................
  0x00,0x00,0x00,0x00,0x00,0x00,0x00,0x00,0x00,0x00,0x00,0x00,0x00,0x00,0x00,0x00, // ................................................................................................................................
  0x00,0x00,0x00,0x00,0x00,0x00,0x00,0x00,0x00,0x00,0x00,0x00,0x00,0x00,0x00,0x00, // ................................................................................................................................
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  0x00,0x00,0x00,0x00,0x00,0x00,0x00,0x00,0x00,0x00,0x00,0x00,0x00,0x00,0x00,0x00  // ................................................................................................................................
};

const unsigned char closed_eye[] PROGMEM = {
  0x00,0x00,0x00,0x00,0x00,0x00,0x00,0x00,0x00,0x00,0x00,0x00,0x00,0x00,0x00,0x00, // ................................................................................................................................
  0x00,0x00,0x00,0x00,0x00,0x00,0x00,0x00,0x00,0x00,0x00,0x00,0x00,0x00,0x00,0x00, // ................................................................................................................................
  0x00,0x00,0x00,0x00,0x00,0x00,0x00,0x00,0x00,0x00,0x00,0x00,0x00,0x00,0x00,0x00, // ................................................................................................................................
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  0x00,0x00,0x00,0x00,0x00,0x00,0x00,0x00,0x00,0x00,0x00,0x00,0x00,0x00,0x00,0x00  // ................................................................................................................................
};

const unsigned char rightLooking[] PROGMEM = {
  0x00,0x00,0x00,0x00,0x00,0x00,0x00,0x00,0x00,0x00,0x00,0x00,0x00,0x00,0x00,0x00, // ................................................................................................................................
  0x00,0x00,0x00,0x00,0x00,0x00,0x00,0x00,0x00,0x00,0x00,0x00,0x00,0x00,0x00,0x00, // ................................................................................................................................
  0x00,0x00,0x00,0x00,0x00,0x00,0x00,0x00,0x00,0x00,0x00,0x00,0x00,0x00,0x00,0x00, // ................................................................................................................................
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  0x00,0x00,0x00,0x00,0x00,0x00,0x00,0x00,0x00,0x00,0x00,0x00,0x00,0x00,0x00,0x00  // ................................................................................................................................
};

const unsigned char leftLooking[] PROGMEM = {
  0x00,0x00,0x00,0x00,0x00,0x00,0x00,0x00,0x00,0x00,0x00,0x00,0x00,0x00,0x00,0x00, // ................................................................................................................................
  0x00,0x00,0x00,0x00,0x00,0x00,0x00,0x00,0x00,0x00,0x00,0x00,0x00,0x00,0x00,0x00, // ................................................................................................................................
  0x00,0x00,0x00,0x00,0x00,0x00,0x00,0x00,0x00,0x00,0x00,0x00,0x00,0x00,0x00,0x00, // ................................................................................................................................
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  0x00,0x00,0x00,0x00,0x00,0x00,0x00,0x00,0x00,0x00,0x00,0x00,0x00,0x00,0x00,0x00  // ................................................................................................................................
};
//Blinking  animation
void blink_eye(){
  display.clearDisplay();
  display.drawBitmap(0,0,opened_eye,128,64,WHITE);
  display.display();
 
  display.clearDisplay();
  display.drawBitmap(0,0,semiopened_eye,128,64,WHITE);
  display.display();
 
  display.clearDisplay();
  display.drawBitmap(0,0,closed_eye,128,64,WHITE);
  display.display();

  display.clearDisplay();
  display.drawBitmap(0,0,semiopened_eye,128,64,WHITE);
  display.display();
  
  display.clearDisplay();
  display.drawBitmap(0,0,opened_eye,128,64,WHITE);
  display.display();
  delay(1000);
}

void lookleft(){
  display.clearDisplay();
  display.drawBitmap(0,0,opened_eye,128,64,WHITE);
  display.display();
  
  display.clearDisplay();
  display.drawBitmap(0,0,closed_eye,128,64,WHITE);
  display.display();

  display.clearDisplay();
  display.drawBitmap(0,0,leftLooking,128,64,WHITE);
  display.display();
  delay(1000);

  display.clearDisplay();
  display.drawBitmap(0,0,closed_eye,128,64,WHITE);
  display.display();
  
  display.clearDisplay();
  display.drawBitmap(0,0,opened_eye,128,64,WHITE);
  display.display();
}

void lookright(){
  display.clearDisplay();
  display.drawBitmap(0,0,opened_eye,128,64,WHITE);
  display.display();

  display.clearDisplay();
  display.drawBitmap(0,0,closed_eye,128,64,WHITE);
  display.display();

  display.clearDisplay();
  display.drawBitmap(0,0,rightLooking,128,64,WHITE);
  display.display();
  delay(1000);

  display.clearDisplay();
  display.drawBitmap(0,0,closed_eye,128,64,WHITE);
  display.display();

  display.clearDisplay();
  display.drawBitmap(0,0,opened_eye,128,64,WHITE);
  display.display();
}

void eyeMoves(){
  blink_eye();
  lookright();lookright();
  blink_eye();
  lookleft();lookleft();
}



void setup() {
  fl.attach(15);//d8-Forward left
  fr.attach(D7);//Forward right
  bl.attach(D6);//Back left
  br.attach(D5);//Back right 
  // Setup serial port
  Serial.begin(115200);
  Serial.println();
  if(!display.begin(SSD1306_SWITCHCAPVCC, 0x3C)) {
    Serial.println(F("SSD1306 allocation failed"));
  }
  display.clearDisplay();

  eyeMoves();
  // Begin WiFi
  WiFi.begin(WIFI_SSID, WIFI_PASS); 
  // Connecting to WiFi...
  Serial.print("Connecting to ");
  Serial.print(WIFI_SSID);
  // Loop continuously while WiFi is not connected
  while (WiFi.status() != WL_CONNECTED)
  {
    delay(100);
    Serial.print(".");
  }
  // Connected to WiFi
  Serial.println();
  Serial.print("Connected! IP address: ");
  Serial.println(WiFi.localIP());
  // Begin listening to UDP port
  UDP.begin(UDP_PORT);
  Serial.print("Listening on UDP port ");
  Serial.println(UDP_PORT);
}

  int len2;
void loop() {
  // If packet received...
  int packetSize = UDP.parsePacket();
  if (packetSize) {
    //Serial.print("Received packet! Size: ");
    //Serial.println(packetSize); 
    int len = UDP.read(packet, 255);
    len2 = len;
    if (len > 0)
    {
      packet[len] = '\0';
    }
    Serial.print("Packet received: ");
    Serial.println(packet);
   sLine = packet;
    // parse only if exists
    if (sLine.length() > 0) {
    // parse the line
    iCount = StringSplit(sLine,',',sParams,4);
    // print the extracted paramters
    for(i=0;i<iCount;i++) {
       // Serial.println(sParams[i]);
    }
    //Direction = atan2(sParams[1].toDouble(),sParams[0].toDouble());
    //Serial.println((Direction));
    
    Serial.println("");
}  

    flss=map(sParams[0].toInt() ,-99,99,1000,2000);//Forward left wheel speed
    frs=map(sParams[1].toInt() ,-99,99,1000,2000);//Forward right wheel speed 
    bls=map(sParams[2].toInt() ,-99,99,1000,2000);//Back left speed
    brs=map(sParams[3].toInt() ,-99,99,1000,2000);//Back right speed

   char buffer[40];
   sprintf(buffer," %d %d",flss,frs);
   Serial.println(buffer);
   sprintf(buffer," %d %d",bls,brs);
   Serial.println(buffer);
    
   
   //Serial.println(flss +"\t"+frs);
  // Serial.prin
  // Serial.println(bls+"\t"+brs);
    motor_forward(flss,frs,bls, brs);
    //Serial.println("Mapped");
   
    //Serial.println(bls);
   // Serial.println(brs);
  }
  //blink_eye();
  //motor_stop();
}



//split data
int StringSplit(String sInput, char cDelim, String sParams[], int iMaxParams)
{
    int iParamCount = 0;
    int iPosDelim, iPosStart = 0;
    do {
        // Searching the delimiter using indexOf()
        iPosDelim = sInput.indexOf(cDelim,iPosStart);
        if (iPosDelim >= (iPosStart+1)) {
            // Adding a new parameter using substring() 
            sParams[iParamCount] = sInput.substring(iPosStart,iPosDelim);//iPosDelim-1
            iParamCount++;
            // Checking the number of parameters
           /* if (iParamCount >= iMaxParams) {
                return (iParamCount);
            }
            */
            iPosStart = iPosDelim + 1;
        }
    } while (iPosDelim >= 0);
    /*
    if (iParamCount < iMaxParams) {
        // Adding the last parameter as the end of the line
        sParams[iParamCount] = sInput.substring(iPosStart);
        iParamCount++;
    }
*/
    return (iParamCount);
}

void motor_forward(int flss,int frs,int bls,int brs)
{
   fl.writeMicroseconds(flss);
   fr.writeMicroseconds(frs);
   bl.writeMicroseconds(bls);
   br.writeMicroseconds(brs);
  }
void motor_stop()
{
   fl.writeMicroseconds(1500);
   fr.writeMicroseconds(1500);
   bl.writeMicroseconds(1500);
   br.writeMicroseconds(1500);
   eyeMoves();  
    }
